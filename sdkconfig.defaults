## sdkconfig.defaults
```kconfig
# 目标芯片：ESP32-S3（陇参卫士除草执行端）
CONFIG_IDF_TARGET="esp32s3"

# 控制台日志走 USB-Serial-JTAG（USB 口），把 UART0 让给 COM 口的 Jetson 行协议
CONFIG_ESP_CONSOLE_USB_SERIAL_JTAG=y

# FreeRTOS tick 1000Hz，便于动作保持等毫秒级计时
CONFIG_FREERTOS_HZ=1000

# 默认日志级别 INFO
CONFIG_LOG_DEFAULT_LEVEL_INFO=y
```
